## dts/bindings/video/arducam,mega.yaml
```yaml
# ARDUCAM_MEGA

# Copyright (c) 2023 Arducam Technology co., Ltd. <www.arducam.com>
# SPDX-License-Identifier: Apache-2.0

description: Arducam Mega CMOS video sensor

compatible: "arducam,mega"

include: spi-device.yaml
```

## samples/subsys/video/mega_full-featured/sample.yaml
```yaml
sample:
  name: arducam mega camera full-featured test
tests:
  sample.video.test:
    build_only: true
    tags: video
    platform_allow:
      - rpi_pico
      - rpi_pico_w
    depends_on: video
    integration_platforms:
      - rpi_pico
      - rpi_pico_w
```
